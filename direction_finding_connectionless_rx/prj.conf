## CMakeLists.txt
```
#
# Copyright (c) 2021 Nordic Semiconductor ASA
#
# SPDX-License-Identifier: Apache-2.0

cmake_minimum_required(VERSION 3.20.0)

find_package(Zephyr REQUIRED HINTS $ENV{ZEPHYR_BASE})

project(direction_finding_connectionless_rx)

target_sources(app PRIVATE
  src/main.c
  src/aoa_calc.c
  src/aoa_calc.h
  src/ble.c
  src/ble.h
  src/est_pos.c
  src/est_pos.h
  src/test/aoa_calc_test.c
  src/test/aoa_calc_test.h
)
```

## prj.conf
```kconfig
CONFIG_BT=y
CONFIG_BT_DEVICE_NAME="DF Connectionless Locator App"

CONFIG_BT_EXT_ADV=y
CONFIG_BT_PER_ADV_SYNC=y
CONFIG_BT_OBSERVER=y

# Enable Direction Finding Feature including AoA and AoD
CONFIG_BT_DF=y
CONFIG_BT_DF_CONNECTIONLESS_CTE_RX=y
CONFIG_NEWLIB_LIBC=y
CONFIG_NEWLIB_LIBC_FLOAT_PRINTF=y
```

## boards/nrf52833dk_nrf52833.overlay
```dts
/*
 * Copyright (c) 2021 Nordic Semiconductor ASA
 *
 * SPDX-License-Identifier: Apache-2.0
 */

&radio {
	status = "okay";
	/* This is an example number of antennas that may be available
	 * on antenna matrix board.
	 */
	dfe-antenna-num = <16>;
	/* This is an example switch pattern that will be used to set an
	 * antenna for Rx PDU (period before start of Rx CTE).
	 */
	dfe-pdu-antenna = <0x0>;

	/* These are example GPIO pin numbers that are provided to
	 * Radio peripheral. The pins will be acquired by Radio to
	 * drive antenna switching when AoA is enabled.
	 */
	dfegpio0-gpios = <&gpio0 3 0>;
	dfegpio1-gpios = <&gpio0 4 0>;
	dfegpio2-gpios = <&gpio0 28 0>;
	dfegpio3-gpios = <&gpio0 29 0>;
};
```

## boards/nrf5340dk_nrf5340_cpuapp.overlay
```dts
/*
 * Copyright (c) 2022 Nordic Semiconductor ASA
 *
 * SPDX-License-Identifier: Apache-2.0
 */

 /* Enable pin forwarding to network core. The selected pins will be used by
  * Radio Direction Finding Extension for antenna switching purposes.
  *
  * Note: Pay attention to assign the same GPIO pins as those provided in
  * network core DTS overlay.
  */
&gpio_fwd {
	dfe-gpio-if {
		gpios = <&gpio0 4 0>,
			<&gpio0 5 0>,
			<&gpio0 6 0>,
			<&gpio0 7 0>;
		};
};
```

## src/main.c
```c
/*
 * Copyright (c) 2021-2024 Nordic Semiconductor ASA
 *
 *  SPDX-License-Identifier: Apache-2.0
 */

#include <stddef.h>
#include <stdint.h>
#include <math.h>
#include <zephyr/kernel.h>
#include <zephyr/sys/printk.h>
#include <zephyr/bluetooth/bluetooth.h>
#include "aoa_calc.h"
#include "ble.h"
#include "est_pos.h"
#include "test/aoa_calc_test.h"

static void aoa_cb(double yaw, double pitch)
{
	own_beacon.yaw[own_beacon.write_idx] = yaw;
	own_beacon.pitch[own_beacon.write_idx] = pitch;
	own_beacon.write_idx = (own_beacon.write_idx + 1) % MAX_AOA_SAMPLES;
	if (own_beacon.sample_count < MAX_AOA_SAMPLES)
		own_beacon.sample_count++;
	double angle_smooth;
	smooth_aoa(yaw, pitch, &angle_smooth);
	printf("Smoothed yaw AoA: %.3f degrees\n", (int)angle_smooth);
	printf("Smoothed pitch AoA: %.3f degrees\n", (int)pitch);
}
bool test = false;
int main(void)
{
	if (test)
	{
		aoa_calc_test();
		return 0;
	}

	ble_ctx_t ble;
	memset(&ble, 0, sizeof(ble));
	bt_addr_le_from_str("FA:23:5E:09:F1:39", "random", &ble.own_beacon_addrs);
	ble.aoa_cb = aoa_cb;
	ble_init(&ble);

	point3d_t position = {10.0, 50.0};
	init_beacon();
	init_beacons();

	printk("Starting Connectionless Locator Demo\n");

	printk("Bluetooth initialization...");
	if (bt_enable(NULL) != 0)
	{
		printk("failed\n");
		return 1;
	}
	printk("success\n");

	do
	{
		if (!ble_scan_enable(&ble))
		{
			printk("Scan enable failed\n");
			return 1;
		}

		printk("Waiting for periodic advertising...");
		ble.per_adv_found = false;
		ble_wait_for_adv(&ble);
		printk("success. Found periodic advertising.\n");

		ble.sync_wait = true;
		ble.sync_terminated = false;

		ble_create_sync(&ble);

		printk("Waiting for periodic sync...\n");
		ble_wait_for_sync(&ble);
		printk("success. Periodic sync established.\n");
		ble.sync_wait = false;

		ble_enable_cte_rx(&ble);

		ble_scan_disable(&ble);

		printk("Waiting for periodic sync lost...\n");
		ble_wait_for_sync_lost(&ble);
		printk("Periodic sync lost.\n");
		printk("AoA samples:\n");
		int idx = own_beacon.write_idx;
		int count = own_beacon.sample_count < 5 ? own_beacon.sample_count : 5;
		for (int i = 0; i < 5; i++)
		{
			// Calculate the index of the i-th most recent sample
			int real_idx = (own_beacon.write_idx - count + i + MAX_AOA_SAMPLES) % MAX_AOA_SAMPLES;
			printk("%d, %d\n", (int)own_beacon.yaw[real_idx], (int)own_beacon.pitch[real_idx]);
		}

		printk("Estimating position...\n");
		if (own_beacon.sample_count > 0)
		{
			int last_idx = (own_beacon.write_idx - 1 + MAX_AOA_SAMPLES) % MAX_AOA_SAMPLES;
			beacons[0].yaw[beacons[0].write_idx] = own_beacon.yaw[last_idx];
			beacons[0].pitch[beacons[0].write_idx] = own_beacon.pitch[last_idx];
			beacons[0].write_idx = (beacons[0].write_idx + 1) % MAX_AOA_SAMPLES;
			if (beacons[0].sample_count < MAX_AOA_SAMPLES)
				beacons[0].sample_count++;
		}
		point3d_t new_position;
		// if (estimate_position(position, &new_position))
		// {
		// 	position = new_position;
		// 	printk("Estimated position: x = %d, y = %d, z = %d\n", (int)(position.x * 1000), (int)(position.y * 1000), (int)(position.z * 1000));
		// }
		// else
		// {
		// 	printk("Position estimation failed.\n");
		// }

	} while (true);

	return 0;
}
```

## src/aoa_calc.c
```c
#include "aoa_calc.h"
#include <math.h>
#include <zephyr/kernel.h>
#include <zephyr/sys/printk.h>
#include <zephyr/sys/byteorder.h>
#include <zephyr/sys/util.h>
#include <zephyr/bluetooth/bluetooth.h>
#include <zephyr/bluetooth/gap.h>
#include <zephyr/bluetooth/direction.h>
#include <zephyr/bluetooth/hci.h>
#include <zephyr/bluetooth/hci_vs.h>
#include <string.h>
#include <stdbool.h>

static double aoa_window[AOA_SMOOTH_WINDOW];
static int aoa_idx = 0;
static int aoa_count = 0;
const char *const beacon_adress = "FA:23:5E:09:F1:39";

struct own_beacon_data own_beacon;

double deg2rad(double deg)
{
	return deg * (double)M_PI / 180.0f;
}

double normalize_angle_180(double angle)
{
	double norm = fmod(angle + 180.0, 360.0);
	if (norm < 0)
		norm += 360.0;
	return norm - 180.0;
}

double phase_diff_to_angle(double phase_diff)
{
	phase_diff = normalize_angle_180(phase_diff);
	printf("Normaliszed phase_diff: %.3f\n", phase_diff);
	return (phase_diff * LAMBDA) / (2.0 * M_PI * D);
}

// Returns true if AoA could be calculated, false otherwise
bool calculate_aoa(const struct bt_df_per_adv_sync_iq_samples_report *report, rot3d_t *angle_deg)
{
	for (int i = 0; i < report->sample_count; i++)
	{
		printk("IQ[%d]: %d, %d\n", i, report->sample[i].i, report->sample[i].q);
	}
	double phase_diff = 0.0;
	int ant1_i = 0;
	int and2_i = 0;
	int ant1_q = 0;
	int and2_q = 0;
	double ant1_angle = 0.0;
	double ant2_angle = 0.0;
	int cnt = 0;
	for (int i = REFFERENCE_SAMPLES; i < report->sample_count; i += 2)
	{
		cnt++;
		ant1_i = report->sample[i].i;
		and2_i = report->sample[i + 1].i;
		ant1_q = report->sample[i].q;
		and2_q = report->sample[i + 1].q;
		ant1_angle = atan2f(ant1_q, ant1_i);
		ant2_angle = atan2f(and2_q, and2_i);
		phase_diff += ant2_angle - ant1_angle;
		printf("Sample %d: Ant1 Angle: %.3f, Ant2 Angle: %.3f, Phase Diff: %.3f\n",
			   i, ant1_angle, ant2_angle, phase_diff);
	}
	phase_diff /= cnt;
	printf("Phase difference: %.3f\n", phase_diff);

	/**
	 * calculate the angle in deg
	 */
	angle_deg->pitch = 0.0;
	angle_deg->yaw = phase_diff_to_angle(phase_diff);
	printf("AoA Yaw: %.3f degrees\n", angle_deg->yaw);
	return true;
}

void smooth_aoa(double new_yaw, double new_pitch, double *smoothed_yaw, double *smoothed_pitch)
{
	static double yaw_window[AOA_SMOOTH_WINDOW];
	static double pitch_window[AOA_SMOOTH_WINDOW];
	static int idx = 0;
	static int count = 0;

	yaw_window[idx] = new_yaw;
	pitch_window[idx] = new_pitch;
	idx = (idx + 1) % AOA_SMOOTH_WINDOW;
	if (count < AOA_SMOOTH_WINDOW)
		count++;

	double sum_yaw = 0.0, sum_pitch = 0.0;
	for (int i = 0; i < count; i++)
	{
		sum_yaw += yaw_window[i];
		sum_pitch += pitch_window[i];
	}
	*smoothed_yaw = sum_yaw / count;
	*smoothed_pitch = sum_pitch / count;
}

void init_beacon(void)
{
	own_beacon.addr = (bt_addr_le_t){0};
	bt_addr_le_from_str(beacon_adress, "random", &own_beacon.addr);
	own_beacon.write_idx = 0;
	own_beacon.sample_count = 0;
	memset(own_beacon.yaw, 0, sizeof(own_beacon.yaw));
	memset(own_beacon.pitch, 0, sizeof(own_beacon.pitch));
	own_beacon.position.position.x = 0.0;
	own_beacon.position.position.y = 0.0;
	own_beacon.position.position.z = 0.0;
	own_beacon.position.rotation.yaw = 0.0;
	own_beacon.position.rotation.pitch = 0.0;
}
```

## src/aoa_calc.h
```c
#ifndef AOA_CALC_H
#define AOA_CALC_H

#include <zephyr/bluetooth/bluetooth.h>
#include <zephyr/bluetooth/direction.h>
#include <stdint.h>
#include <stdbool.h>

#ifndef SPEED_OF_LIGHT
#define SPEED_OF_LIGHT 299792458.0f
#endif
#ifndef M_PI
#define M_PI 3.14159265358979323846
#endif
#define BLE_FREQ 2.44e9f // Hz (for channel 37)
#define LAMBDA (SPEED_OF_LIGHT / BLE_FREQ)
#define D 0.05f // Antenna spacing (meters)

#define ANTENNA_PATTERN_LEN 16

#define AOA_SMOOTH_WINDOW 8
#define MAX_AOA_SAMPLES 32
#define REFFERENCE_SAMPLES 8

typedef struct
{
	double x;
	double y;
	double z;
} point3d_t;

typedef struct
{
	double yaw;	  // rototion Angle in degrees
	double pitch; // Elevation angle in degrees
} rot3d_t;

typedef struct
{
	point3d_t position;
	rot3d_t rotation;
} beacon_t;

struct own_beacon_data
{
	bt_addr_le_t addr;
	double yaw[MAX_AOA_SAMPLES];
	double pitch[MAX_AOA_SAMPLES];
	int write_idx;
	int sample_count;
	beacon_t position;
};

extern struct own_beacon_data own_beacon;

// All functions now use return parameters and return void or bool for success
bool calculate_aoa(const struct bt_df_per_adv_sync_iq_samples_report *report, rot3d_t *angle_deg);
double normalize_angle_180(double angle);
double deg2rad(double deg);
bool gradient_descent(point3d_t prev_xy, point3d_t *est_xy);
bool estimate_position(point3d_t prev_xy, point3d_t *est_xy);
void init_beacon(void);

#endif // AOA_CALC_H
```

## src/ble.c
```c
#include "ble.h"
#include <zephyr/sys/printk.h>
#include <zephyr/sys/util.h>
#include <zephyr/bluetooth/direction.h>
#include <zephyr/bluetooth/hci.h>
#include <zephyr/bluetooth/hci_vs.h>
#include <string.h>
#include "aoa_calc.h"

#define NAME_LEN 30
#define SYNC_CREATE_TIMEOUT_INTERVAL_NUM 10
#define ADV_DATA_HEX_STR_LEN_MAX (BT_GAP_ADV_MAX_EXT_ADV_DATA_LEN * 2 + 1)

#if defined(CONFIG_BT_DF_CTE_RX_AOA)
const static uint8_t ant_patterns[] = {
    0x5, 0x4
    // 0x5, 0x4, 0x7, 0x6, 0x1, 0x0, 0x3, 0x2, // Antenna switching pattern
    // 0xD, 0xC, 0xF, 0xE, 0x9, 0x8, 0xB, 0xA
};
#endif
int num = 0;

static ble_ctx_t *ble_ctx_ptr = NULL;

static uint16_t sync_create_timeout_get(uint16_t interval)
{
    uint32_t interval_us;
    uint32_t timeout;
    interval_us = BT_GAP_PER_ADV_INTERVAL_TO_US(interval);
    timeout = BT_GAP_US_TO_PER_ADV_SYNC_TIMEOUT(interval_us) * SYNC_CREATE_TIMEOUT_INTERVAL_NUM;
    timeout = CLAMP(timeout, BT_GAP_PER_ADV_MIN_TIMEOUT, BT_GAP_PER_ADV_MAX_TIMEOUT);
    return (uint16_t)timeout;
}

static bool data_cb(struct bt_data *data, void *user_data)
{
    char *name = user_data;
    uint8_t len;

    switch (data->type)
    {
    case BT_DATA_NAME_SHORTENED:
    case BT_DATA_NAME_COMPLETE:
        len = MIN(data->data_len, NAME_LEN - 1);
        memcpy(name, data->data, len);
        name[len] = '\0';
        return false;
    default:
        return true;
    }
}

static void sync_cb(struct bt_le_per_adv_sync *sync, struct bt_le_per_adv_sync_synced_info *info)
{
    ble_ctx_t *ctx = ble_ctx_ptr;
    char le_addr[BT_ADDR_LE_STR_LEN];
    bt_addr_le_to_str(info->addr, le_addr, sizeof(le_addr));
    printk("PER_ADV_SYNC[%u]: [DEVICE]: %s synced, Interval 0x%04x (%u ms), PHY %u\n",
           bt_le_per_adv_sync_get_index(sync), le_addr, info->interval, info->interval * 5 / 4,
           info->phy);
    k_sem_give(&ctx->sem_per_sync);
}

static void term_cb(struct bt_le_per_adv_sync *sync, const struct bt_le_per_adv_sync_term_info *info)
{
    ble_ctx_t *ctx = ble_ctx_ptr;
    char le_addr[BT_ADDR_LE_STR_LEN];
    bt_addr_le_to_str(info->addr, le_addr, sizeof(le_addr));
    printk("PER_ADV_SYNC[%u]: [DEVICE]: %s sync terminated\n",
           bt_le_per_adv_sync_get_index(sync), le_addr);

    if (ctx->sync_wait)
    {
        ctx->sync_terminated = true;
        k_sem_give(&ctx->sem_per_sync);
    }
    else
    {
        k_sem_give(&ctx->sem_per_sync_lost);
    }
}

static void recv_cb(struct bt_le_per_adv_sync *sync, const struct bt_le_per_adv_sync_recv_info *info, struct net_buf_simple *buf)
{
    static char data_str[ADV_DATA_HEX_STR_LEN_MAX];
    char le_addr[BT_ADDR_LE_STR_LEN];
    bt_addr_le_to_str(info->addr, le_addr, sizeof(le_addr));
    bin2hex(buf->data, buf->len, data_str, sizeof(data_str));
    printk("PER_ADV_SYNC[%u]: [DEVICE]: %s, tx_power %i, RSSI %i, data length %u, data: %s\n",
           bt_le_per_adv_sync_get_index(sync), le_addr, info->tx_power, info->rssi,
           buf->len, data_str);
}

static void cte_recv_cb(struct bt_le_per_adv_sync *sync, const struct bt_df_per_adv_sync_iq_samples_report *report)
{
    ble_ctx_t *ctx = ble_ctx_ptr;
    rot3d_t angle;
    // You must provide your own AoA calculation function!
    extern bool calculate_aoa(const struct bt_df_per_adv_sync_iq_samples_report *report, rot3d_t *angle_deg);
    if (!calculate_aoa(report, &angle))
    {
        printk("AoA calculation failed\n");
        return;
    }

    struct bt_le_per_adv_sync_info info;
    bt_le_per_adv_sync_get_info(sync, &info);

    ctx->aoa_cb(angle);

    ble_delete_sync(ctx);
}

static void scan_recv(const struct bt_le_scan_recv_info *info, struct net_buf_simple *buf)
{
    ble_ctx_t *ctx = ble_ctx_ptr;
    char le_addr[BT_ADDR_LE_STR_LEN];
    char name[NAME_LEN];
    (void)memset(name, 0, sizeof(name));
    bt_data_parse(buf, data_cb, name);
    bt_addr_le_to_str(info->addr, le_addr, sizeof(le_addr));

    if (!ctx->per_adv_found && info->interval != 0)
    {
        ctx->sync_create_timeout = sync_create_timeout_get(info->interval);
        ctx->per_adv_found = true;
        ctx->per_sid = info->sid;
        bt_addr_le_copy(&ctx->per_addr, info->addr);
        k_sem_give(&ctx->sem_per_adv);
    }
}

static struct bt_le_per_adv_sync_cb sync_callbacks = {
    .synced = sync_cb,
    .term = term_cb,
    .recv = recv_cb,
    .cte_report_cb = cte_recv_cb,
};

static struct bt_le_scan_cb scan_callbacks = {
    .recv = scan_recv,
};

void ble_init(ble_ctx_t *ctx)
{
    ble_ctx_ptr = ctx;
    k_sem_init(&ctx->sem_per_adv, 0, 1);
    k_sem_init(&ctx->sem_per_sync, 0, 1);
    k_sem_init(&ctx->sem_per_sync_lost, 0, 1);
    ctx->scan_enabled = false;
    ctx->per_adv_found = false;
    ctx->sync_wait = false;
    ctx->sync_terminated = false;
    bt_le_scan_cb_register(&scan_callbacks);
    bt_le_per_adv_sync_cb_register(&sync_callbacks);
}

bool ble_scan_enable(ble_ctx_t *ctx)
{
    struct bt_le_scan_param param = {
        .type = BT_LE_SCAN_TYPE_ACTIVE,
        .options = BT_LE_SCAN_OPT_FILTER_DUPLICATE,
        .interval = BT_GAP_SCAN_FAST_INTERVAL,
        .window = BT_GAP_SCAN_FAST_WINDOW,
        .timeout = 0U,
    };
    int err;

    if (!ctx->scan_enabled)
    {
        printk("Start scanning...");
        err = bt_le_scan_start(&param, NULL);
        if (err != 0)
        {
            printk("failed (err %d)\n", err);
            return false;
        }
        printk("success\n");
        ctx->scan_enabled = true;
    }
    return true;
}

void ble_scan_disable(ble_ctx_t *ctx)
{
    int err;
    printk("Scan disable...");
    err = bt_le_scan_stop();
    if (err != 0)
    {
        printk("failed (err %d)\n", err);
        return;
    }
    printk("Success.\n");
    ctx->scan_enabled = false;
}

void ble_create_sync(ble_ctx_t *ctx)
{
    int err;
    printk("Creating Periodic Advertising Sync...");
    printk(" with address %s, SID %u, timeout %u ms...",
           bt_addr_le_str(&ctx->per_addr), ctx->per_sid, ctx->sync_create_timeout);
    bt_addr_le_copy(&ctx->sync_create_param.addr, &ctx->per_addr);
    ctx->sync_create_param.options = BT_LE_PER_ADV_SYNC_OPT_SYNC_ONLY_CONST_TONE_EXT;
    ctx->sync_create_param.sid = ctx->per_sid;
    ctx->sync_create_param.skip = 0;
    ctx->sync_create_param.timeout = ctx->sync_create_timeout;
    err = bt_le_per_adv_sync_create(&ctx->sync_create_param, &ctx->adv_sync);
    if (err != 0)
    {
        printk("failed (err %d)\n", err);
        return;
    }
    printk("success.\n");
}

void ble_enable_cte_rx(ble_ctx_t *ctx)
{
    int err;
    const struct bt_df_per_adv_sync_cte_rx_param cte_rx_params = {
        .max_cte_count = 5,
#if defined(CONFIG_BT_DF_CTE_RX_AOA)
        .cte_types = BT_DF_CTE_TYPE_ALL,
        .slot_durations = 0x2,
        .num_ant_ids = ARRAY_SIZE(ant_patterns),
        .ant_ids = ant_patterns,
#else
        .cte_types = BT_DF_CTE_TYPE_AOD_1US | BT_DF_CTE_TYPE_AOD_2US,
#endif
    };
    printk("Enable receiving of CTE...\n");
    err = bt_df_per_adv_sync_cte_rx_enable(ctx->adv_sync, &cte_rx_params);
    if (err != 0)
    {
        printk("failed (err %d)\n", err);
        return;
    }
    printk("success. CTE receive enabled.\n");
}

void ble_delete_sync(ble_ctx_t *ctx)
{
    int err;
    printk("Deleting Periodic Advertising Sync...");
    err = bt_le_per_adv_sync_delete(ctx->adv_sync);
    if (err != 0)
    {
        printk("failed (err %d)\n", err);
        return;
    }
    printk("success\n");
}

void ble_wait_for_adv(ble_ctx_t *ctx)
{
    k_sem_take(&ctx->sem_per_adv, K_FOREVER);
}

void ble_wait_for_sync(ble_ctx_t *ctx)
{
    k_sem_take(&ctx->sem_per_sync, K_FOREVER);
}

void ble_wait_for_sync_lost(ble_ctx_t *ctx)
{
    k_sem_take(&ctx->sem_per_sync_lost, K_FOREVER);
}
```

## src/ble.h
```c
#ifndef BLE_LE_H
#define BLE_LE_H

#include <zephyr/bluetooth/bluetooth.h>
#include <zephyr/bluetooth/gap.h>
#include <zephyr/bluetooth/direction.h>
#include <stdbool.h>
#include <stdint.h>
#include <zephyr/kernel.h>
#include "aoa_calc.h"

typedef void (*ble_aoa_report_cb_t)(rot3d_t angle);

typedef struct
{
    struct bt_le_per_adv_sync_param sync_create_param;
    struct bt_le_per_adv_sync *adv_sync;
    bt_addr_le_t own_beacon_addrs;
    bool per_adv_found;
    bool scan_enabled;
    bool sync_wait;
    bool sync_terminated;
    uint8_t per_sid;
    uint16_t sync_create_timeout;
    struct k_sem sem_per_adv;
    struct k_sem sem_per_sync;
    struct k_sem sem_per_sync_lost;
    ble_aoa_report_cb_t aoa_cb;
    bt_addr_le_t per_addr;

} ble_ctx_t;

void ble_init(ble_ctx_t *ctx);
bool ble_scan_enable(ble_ctx_t *ctx);
void ble_scan_disable(ble_ctx_t *ctx);
void ble_create_sync(ble_ctx_t *ctx);
void ble_enable_cte_rx(ble_ctx_t *ctx);
void ble_delete_sync(ble_ctx_t *ctx);

void ble_wait_for_adv(ble_ctx_t *ctx);
void ble_wait_for_sync(ble_ctx_t *ctx);
void ble_wait_for_sync_lost(ble_ctx_t *ctx);

#endif
```

## src/est_pos.c
```c
#include "est_pos.h"

#include <math.h>

struct beacon_data beacons[NUM_BEACONS];

void distance_to_plane(point3d_t p, point3d_t beacon, double yaw_deg, double pitch_deg, double *dist)
{
    printk("Calculating distance to plane");
    double yaw = deg2rad(yaw_deg);
    double pitch = deg2rad(pitch_deg);

    // Normal vector from yaw/pitch
    double nx = cos(pitch) * cos(yaw);
    double ny = cos(pitch) * sin(yaw);
    double nz = sin(pitch);

    // Vector from beacon to point
    double dx = p.x - beacon.x;
    double dy = p.y - beacon.y;
    double dz = p.z - beacon.z;

    // Distance from point to plane
    *dist = dx * nx + dy * ny + dz * nz;
}

static inline void total_cost(point3d_t p, double *cost)
{
    printk("Calculating cost");
    *cost = 0.0f;
    for (int i = 0; i < NUM_BEACONS; i++)
    {
        if (beacons[i].sample_count == 0)
        {
            continue;
        }
        int n = beacons[i].sample_count < 3 ? beacons[i].sample_count : 3;
        double sum_yaw = 0.0f;
        double sum_pitch = 0.0f;
        for (int j = 0; j < n; j++)
        {
            int idx = (beacons[i].write_idx - n + j + MAX_AOA_SAMPLES) % MAX_AOA_SAMPLES;
            sum_yaw += beacons[i].yaw[idx];
            sum_pitch += beacons[i].pitch[idx];
        }
        double avg_yaw = sum_yaw / n;
        double avg_pitch = sum_pitch / n;
        double dist;
        distance_to_plane(
            p,
            beacons[i].position.position,
            avg_yaw,
            avg_pitch,
            &dist);
        *cost += dist * dist;
    }
}

void compute_gradient(point3d_t p, point3d_t *grad)
{
    printk("Computing gradient");
    double h = 0.001f;
    point3d_t p_x_plus = {p.x + h, p.y, p.z};
    point3d_t p_x_minus = {p.x - h, p.y, p.z};
    point3d_t p_y_plus = {p.x, p.y + h, p.z};
    point3d_t p_y_minus = {p.x, p.y - h, p.z};
    point3d_t p_z_plus = {p.x, p.y, p.z + h};
    point3d_t p_z_minus = {p.x, p.y, p.z - h};

    double cost_x_plus, cost_x_minus, cost_y_plus, cost_y_minus, cost_z_plus, cost_z_minus;
    printk("Calculating costs for gradient");
    printk("p_x_plus: %d, %d, %d", p_x_plus.x, p_x_plus.y, p_x_plus.z);
    total_cost(p_x_plus, &cost_x_plus);
    total_cost(p_x_minus, &cost_x_minus);
    total_cost(p_y_plus, &cost_y_plus);
    total_cost(p_y_minus, &cost_y_minus);
    total_cost(p_z_plus, &cost_z_plus);
    total_cost(p_z_minus, &cost_z_minus);

    grad->x = (cost_x_plus - cost_x_minus) / (2.0f * h);
    grad->y = (cost_y_plus - cost_y_minus) / (2.0f * h);
    grad->z = (cost_z_plus - cost_z_minus) / (2.0f * h);
}

bool gradient_descent(point3d_t prev_xyz, point3d_t *est_xyz)
{
    double learning_rate = 0.08f;
    int max_iterations = 50;
    double epsilon = 1e-3f;
    int i = 0;
    point3d_t grad;
    double norm = INFINITY;
    point3d_t p = prev_xyz;

    // Check if enough data is available
    for (int i = 0; i < NUM_BEACONS; i++)
    {
        if (beacons[i].sample_count < 3)
        {
            printk("Not enough AoA-data for Beacon %d\n", i);
            *est_xyz = prev_xyz;
            return false;
        }
    }

    do
    {
        compute_gradient(p, &grad);
        norm = sqrtf(grad.x * grad.x + grad.y * grad.y + grad.z * grad.z);
        p.x -= learning_rate * grad.x;
        p.y -= learning_rate * grad.y;
        p.z -= learning_rate * grad.z;
    } while (++i < max_iterations && norm > epsilon);

    est_xyz->x = p.x;
    est_xyz->y = p.y;
    est_xyz->z = p.z;
    return true;
}

bool estimate_position(point3d_t prev_xy, point3d_t *est_xy)
{
    return gradient_descent(prev_xy, est_xy);
}

void init_beacons(void)
{
    for (int i = 0; i < NUM_BEACONS; i++)
    {
        bt_addr_le_from_str("FA:23:5E:09:F1:39", "random", &beacons[i].addr);
        beacons[i].position = (beacon_t){{0.0, 0.0, 0.0}, 0, 0};
        beacons[i].sample_count = 0;
        beacons[i].write_idx = 0;
        memset(beacons[i].yaw, 0, sizeof(beacons[i].yaw));
        memset(beacons[i].pitch, 0, sizeof(beacons[i].pitch));
    }
}
```

## src/est_pos.h
```c
#ifndef EST_POS_H
#define EST_POS_H

#include "aoa_calc.h"

#include <stdint.h>
#include <stdbool.h>
#include <zephyr/bluetooth/bluetooth.h>

#define NUM_BEACONS 1

struct beacon_data
{
    bt_addr_le_t addr;
    double yaw[MAX_AOA_SAMPLES];
    double pitch[MAX_AOA_SAMPLES];
    int sample_count;
    int write_idx;
    beacon_t position;
};

extern struct beacon_data beacons[NUM_BEACONS];

bool estimate_position(point3d_t prev_xy, point3d_t *est_xy);
void init_beacons(void);

#endif // EST_POS_H
```
